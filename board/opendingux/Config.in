## board/opendingux/Config.in
```kconfig
menu "OpenDingux packages"
comment "Emulators"
	source "$BR2_EXTERNAL/package/pcsx4all/Config.in"
	source "$BR2_EXTERNAL/package/pocketsnes/Config.in"

comment "Frontends"
	source "$BR2_EXTERNAL/package/gmenu2x/Config.in"
	source "$BR2_EXTERNAL/package/gmenunx/Config.in"

comment "Games"
	source "$BR2_EXTERNAL/package/blockattack/Config.in"
	source "$BR2_EXTERNAL/package/gng/Config.in"
	source "$BR2_EXTERNAL/package/hocoslamfy/Config.in"

comment "Libraries"
	source "$BR2_EXTERNAL/package/allegro/Config.in"
	source "$BR2_EXTERNAL/package/libini/Config.in"
	source "$BR2_EXTERNAL/package/libopk/Config.in"
	source "$BR2_EXTERNAL/package/libshake/Config.in"
	source "$BR2_EXTERNAL/package/libxdgmime/Config.in"
	source "$BR2_EXTERNAL/package/love2d/Config.in"
	source "$BR2_EXTERNAL/package/utf8cpp/Config.in"

comment "System tools"
	source "$BR2_EXTERNAL/package/od-network-config/Config.in"
	source "$BR2_EXTERNAL/package/pwswd/Config.in"
endmenu
```

## board/opendingux/package/blockattack/Config.in
```kconfig
config BR2_PACKAGE_BLOCKATTACK
	bool "blockattack"
	select BR2_PACKAGE_BOOST
	select BR2_PACKAGE_BOOST_PROGRAM_OPTIONS
	select BR2_PACKAGE_SDL2
	select BR2_PACKAGE_SDL2_IMAGE
	select BR2_PACKAGE_SDL2_MIXER
	select BR2_PACKAGE_SDL2_TTF
	select BR2_PACKAGE_PHYSFS
	select BR2_PACKAGE_UTF8CPP
	select BR2_PACKAGE_GETTEXT
	help
	  Block Attack - Rise of the Blocks
	
	  A Tetris Attack Clone under the GPL.

	  https://blockattack.net/
```

## board/opendingux/package/libshake1/Config.in
```kconfig
config BR2_PACKAGE_LIBSHAKE1
	bool "libshake1"
	help
	  An older version of libshake.
	  Build for compatibility with older OPKs.

	  https://github.com/zear/libShake
```

## board/opendingux/package/pcsx4all/Config.in
```kconfig
config BR2_PACKAGE_PCSX4ALL
	bool "pcsx4all"
	select BR2_PACKAGE_DEJAVU
	select BR2_PACKAGE_LIBPNG
	select BR2_PACKAGE_SDL
	select BR2_PACKAGE_SDL_TTF
	help
	  pcsx4all emulator package
	  https://github.com/dmitrysmagin/pcsx4all

if BR2_PACKAGE_PCSX4ALL

config BR2_PACKAGE_PCSX4ALL_PLATFORM
	string "Target platform"
endif
```

## board/opendingux/package/pocketsnes/Config.in
```kconfig
config BR2_PACKAGE_POCKETSNES
	bool "PocketSNES"
	select BR2_PACKAGE_DEJAVU
	select BR2_PACKAGE_LIBPNG
	select BR2_PACKAGE_SDL
	select BR2_PACKAGE_SDL_TTF
	help
	  PocketSNES emulator package
	  https://github.com/soarqin/PocketSNES

if BR2_PACKAGE_POCKETSNES

config BR2_PACKAGE_POCKETSNES_PLATFORM
	string "Target platform"
endif
```

## board/opendingux/package/utf8cpp/Config.in
```kconfig
config BR2_PACKAGE_UTF8CPP
	bool "utf8cpp"
	help
	  UTF-8 with C++ in a Portable Way
	
	  https://github.com/nemtrif/utfcpp
```

## package/devil/Config.in
```kconfig
config BR2_PACKAGE_DEVIL
	bool "devil"
	select BR2_PACKAGE_LIBPNG
	help
	  A full featured cross-platform image library.

	  http://openil.sourceforge.net/
	depends on BR2_PACKAGE_HAS_LIBGLES
```

## package/x11r7/xlib_libpciaccess/Config.in
```kconfig
config BR2_PACKAGE_XLIB_LIBPCIACCESS
	bool "libpciaccess"
	help
	  X.Org libpciaccess
```
